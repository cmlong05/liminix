// SPDX-License-Identifier: GPL-2.0-or-later
/*
 * Overrides for the JDCloud RE-CS-02, included through
 * hardware.dts.includes after upstream's board dts.
 *
 * This is the complete list of places where the device tree we build
 * differs from what upstream describes. They are overrides rather than
 * patches so that every upstream file stays byte for byte: the board dts,
 * the board dtsi and the fetched ipq6018-ess.dtsi are all used as taken.
 */

/*
 * Bluetooth port. Upstream's ipq6018.dtsi leaves &blsp1_uart6 disabled and
 * upstream's board dtsi enables it with its pin group (gpio48/49 muxed to
 * blsp5_uart), but this board has no Bluetooth - nor does the sibling board
 * upstream writes no such block for (ipq6010-re-cs-07.dts). Leaving it
 * "okay" is not inert: CONFIG_SERIAL_MSM is enabled for the console, so the
 * node binds and registers a second tty, and the pin group drives two pins
 * to a serial function whose wiring on this board we do not know. The
 * btuart-pins group stays in the tree as upstream defines it; with no
 * enabled device referencing it, pinctrl never applies it. If a Bluetooth
 * module turns out to be wired to that port, deleting this override is all
 * it takes.
 */
&blsp1_uart6 {
	status = "disabled";
};

/*
 * AHB radio's remoteproc. enable it in the N5 step
 */
&q6v5_wcss {
	status = "disabled";
};
